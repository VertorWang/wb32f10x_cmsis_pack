# WB32F10x register map
File version: 1.2
CPU: CM3 r2p0, little endian, MPU, no FPU, 4 interrupt priority bits
Registers are 32-bit, read-write, reset 0x0 unless marked. A register's access mark holds for its fields unless they carry their own. Offsets are from the block's base; lines under a group give offsets from that group; [hi:lo] are bit positions; {n}, {i} and the like mark numbered series; 'fields as' and 'values as' point back to an identical list; <NAME> marks a mode.

## Memory map
0x40000000 GPIOA size 0x400 — General-purpose and alternate-function I/O
0x40000400 GPIOB size 0x400 — General-purpose and alternate-function I/O
0x40000800 GPIOC size 0x400 — General-purpose and alternate-function I/O
0x40000C00 GPIOD size 0x400 — General-purpose and alternate-function I/O
0x40001400 AFIO size 0x400 — AFIO registers
0x40001800 EXTI size 0x400 — Interrupt/event controller
0x40001C00 TIM1 size 0x400 — Timer 1
0x40002000 TIM2 size 0x400 — Timer 2
0x40002400 TIM3 size 0x400 — Timer 3
0x40002800 TIM4 size 0x400 — Timer 4
0x40003000 QSPI size 0x400 — Queue Serial peripheral interface controller
0x40003400 SPIS1 size 0x400 — Serial Peripheral Interface slave 1
0x40003800 UART1 size 0x400 — Universal Asynchronous 1
0x40003C00 ADC size 0x400 — Analog to digital conversion
0x40007C00 DMAC1 size 0x400 — Direct memory access controller1 1
0x40008000 UART2 size 0x400 — Universal Asynchronous 2
0x40008400 UART3 size 0x400 — Universal Asynchronous 3
0x40008800 I2C1 size 0x400 — Inter-Integrated Circuit 1
0x40008C00 I2C2 size 0x400 — Inter-Integrated Circuit 2
0x40009000 SPIM2 size 0x400 — Serial Peripheral Interface master 2
0x40009400 SPIS2 size 0x400 — Serial Peripheral Interface slave 2
0x40009800 WWDG size 0x400 — Window watchdog
0x4000B400 I2S size 0x400 — Inter-IC Sound Bus
0x4000B800 RNG size 0x400 — Random Number Generator
0x4000BC00 LED size 0x400 — LED driver controller
0x4000FC00 DMAC2 size 0x400 — Direct memory access controller1 2
0x40010000 PWR size 0x400 — Power control
0x40010400 ANCTL size 0x400 — Analog control
0x40010800 IWDG size 0x400 — Independent watchdog
0x40010C00 RCC size 0x400 — Reset and Clock Control
0x40014000 USB size 0x400 — Universal Serial Bus
0x40014800 CRC size 0x400 — Cyclic Redundancy Check
0x40014C00 SFM size 0x400 — Special function macro
0x40015400 CACHE size 0x400 — Cache controller
0x40015800 RTC size 0x400 — Real time clock controller
0x40015C00 BKP size 0x400 — Backup registers
0x40016000 ISO size 0x400 — ISO7816 controller
0x40016400 SYS size 0x400 — System configuration
0x40017800 FMC size 0x400 — Flash memory controller
0xE0042000 DBGMCU size 0x400 — Debug MCU

## Interrupts
0 WWDG — WWDG interrupt
1 PVD (PWR) — PVD through EXTI Line detection interrupt
2 Tamper (BKP) — Tamper interrupt
3 RTC — RTC interrupt
4 FMC — FMC interrupt
5 RCC — RCC interrupt
6 EXTI0 (EXTI) — EXTI Line0 interrupt
7 EXTI1 (EXTI) — EXTI Line1 interrupt
8 EXTI2 (EXTI) — EXTI Line2 interrupt
9 EXTI3 (EXTI) — EXTI Line3 interrupt
10 EXTI4 (EXTI) — EXTI Line4 interrupt
11 DMAC1 — DMAC1 interrupt
12 DMAC2 — DMAC2 interrupt
13 ADC — Analog/Digital conversion interrupt
14 USB — USB interrupt
15 USB_DMA (USB) — USB DMA interrupt
16 EXTI9_5 (EXTI) — EXTI Line[9:5] interrupt
17 TIM1_BRK (TIM1) — TIM1 break interrupt
18 TIM1_UP (TIM1) — TIM1 update interrupt
19 TIM1_TRG_COM (TIM1) — TIM1 trigger or communication interrupt
20 TIM1_CC (TIM1) — TIM1 capture or compare interrupt
21 TIM2 — TIM2 interrupt
22 TIM3 — TIM3 interrupt
23 TIM4 — TIM4 interrupt
24 I2C1 — I2C1 interrupt
25 I2C2 — I2C2 interrupt
26 QSPI — QSPI interrupt
27 SPIM2 — SPIM2 interrupt
28 SPIS1 — SPIS1 interrupt
29 SPIS2 — SPIS2 interrupt
30 UART1 — UART1 interrupt
31 UART2 — UART2 interrupt
32 UART3 — UART3 interrupt
33 EXTI15_10 (EXTI) — EXTI Line[15:10] interrupt
34 RTCAlarm (RTC) — RTC alarm interrupt
35 USB_WKUP (USB) — USB wakeup interrupt
36 I2S — I2S interrupt
37 ISO — ISO7816 interrupt

## Licence text in the file
ARM Limited (ARM) is supplying this software for use with Cortex-M processor based microcontroller, but can be equally used for other suitable processor architectures. This file can be freely distributed. Modifications to this file shall be clearly marked. THIS SOFTWARE IS PROVIDED "AS IS". NO WARRANTIES, WHETHER EXPRESS, IMPLIED OR STATUTORY, INCLUDING, BUT NOT LIMITED TO, IMPLIED WARRANTIES OF MERCHANTABILITY AND FITNESS FOR A PARTICULAR PURPOSE APPLY TO THIS SOFTWARE. ARM SHALL NOT, IN ANY CIRCUMSTANCES, BE LIABLE FOR SPECIAL, INCIDENTAL, OR CONSEQUENTIAL DAMAGES, FOR ANY REASON WHATSOEVER.
